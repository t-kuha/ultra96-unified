## v1/vitis-ai/petalinux/project-spec/configs/configs/Kconfig
```kconfig
mainmenu "PetaLinux System Configuration"
config SUBSYSTEM_TYPE_LINUX
        bool
        default y
        select SYSTEM_ZYNQMP

config SYSTEM_ZYNQMP
        bool "ZYNQMP Configuration"
        help
          ZYNQMP Configuration for petalinux project.
          All these config options will be in /home/imagingtechnerd/disk/2024.1/ultra96-unified/v1/vitis-ai/petalinux/project-spec/configs/config

config SUBSYSTEM_VARIANT_ZYNQMPEG
        bool
        default y
        help

config SUBSYSTEM_DISTRO_PETALINUX
        bool
        default y
        help

source /home/imagingtechnerd/disk/2024.1/ultra96-unified/v1/vitis-ai/petalinux/project-spec/configs/configs/Kconfig.main
```

## v2/accel/petalinux/project-spec/configs/configs/Kconfig
```kconfig
mainmenu "PetaLinux System Configuration"
config SUBSYSTEM_TYPE_LINUX
        bool
        default y
        select SYSTEM_ZYNQMP

config SYSTEM_ZYNQMP
        bool "ZYNQMP Configuration"
        help
          ZYNQMP Configuration for petalinux project.
          All these config options will be in /home/imagingtechnerd/ultra96-unified/v2/accel/petalinux/project-spec/configs/config

config SUBSYSTEM_VARIANT_ZYNQMPEG
        bool
        default y
        help

config SUBSYSTEM_DISTRO_PETALINUX
        bool
        default y
        help

source /home/imagingtechnerd/ultra96-unified/v2/accel/petalinux/project-spec/configs/configs/Kconfig.main
```

## v2/tensil/petalinux/project-spec/configs/configs/Kconfig.syshw
```kconfig
menu "Subsystem Hardware Settings"

config SUBSYSTEM_PROCESSOR0_IP_NAME
	string
	default psu_cortexa53_0

config SUBSYSTEM_ENABLE_ARCH64
	bool
	default y
	select SUBSYSTEM_ARCH_AARCH64
	depends on SUBSYSTEM_PROCESSOR_psu_cortexa53_0_SELECT

choice
	prompt "System Processor"
	help
	Select a processor as the system processor.

config SUBSYSTEM_PROCESSOR_psu_cortexa53_0_SELECT
	bool "psu_cortexa53_0"

endchoice

if SUBSYSTEM_PROCESSOR_psu_cortexa53_0_SELECT

menu "Memory Settings"
choice
	prompt "Primary Memory"
	default SUBSYSTEM_MEMORY_PSU_DDR_0_SELECT

	help
	The configuration in this menu impacts the
	memory settings in the device tree autoconfig files.
	If you select "manual",
	PetaLinux will auto generate memory node based on user inputs,
	you will need to specify base address and memory size.
	To skip generating lower or upper memory node specify 0x0 offset to the memory size.

config SUBSYSTEM_MEMORY_PSU_DDR_0_SELECT
	bool "psu_ddr_0"

config SUBSYSTEM_MEMORY_MANUAL_SELECT
	bool "manual"

endchoice

config SUBSYSTEM_MEMORY_PSU_DDR_0_BASEADDR
	hex "System memory base address"
	default 0x0
	range 0x0 0x7dffffff
	depends on SUBSYSTEM_MEMORY_PSU_DDR_0_SELECT
	help
	Start address of the system memory.
	It has to be within the selected primary memory physical address range.
	Make sure the DT memory entry should start with provided address.

config SUBSYSTEM_MEMORY_PSU_DDR_0_SIZE
	hex "System memory size"
	default 0x80000000
	range 0x2000000 0x80000000
	depends on SUBSYSTEM_MEMORY_PSU_DDR_0_SELECT
	help
	Size of the system memory. Minimum is 32MB, maximum is the size of
	the selected primary memory physical address range.

config SUBSYSTEM_MEMORY_PSU_DDR_0_U__BOOT_TEXTBASE_OFFSET
	hex "u-boot text base address"
	default 0x8000000 if SUBSYSTEM_ARCH_AARCH64
	default 0x4000000 if SUBSYSTEM_ARCH_ARM
	default 0x100000 if SUBSYSTEM_ARCH_MICROBLAZE
	range 0x100000 0x7e0fffff
	depends on SUBSYSTEM_MEMORY_PSU_DDR_0_SELECT
	depends on !SUBSYSTEM_COMPONENT_U__BOOT_NAME_NONE
	help
	u-boot text base address by specifying from the memory base address.
	u-boot load address = bank base address + offset. And same value will
	pass to TF-A also. Minimum suggested is 1MB.

config SUBSYSTEM_MEMORY_IP_NAME
	string
	default psu_ddr_0
	depends on SUBSYSTEM_MEMORY_PSU_DDR_0_SELECT

config SUBSYSTEM_MEMORY_MANUAL_LOWER_BASEADDR
	hex "Lower memory base address"
	default 0x0
	depends on SUBSYSTEM_MEMORY_MANUAL_SELECT
	help
	base address of the lower memory
	Make sure the DT memory entry should start with provided address.

config SUBSYSTEM_MEMORY_MANUAL_LOWER_MEMORYSIZE
	hex "Lower memory size"
	default 0x80000000
	depends on SUBSYSTEM_MEMORY_MANUAL_SELECT
	help
	Size of the lower memory. Minimum is 32MB, maximum is the size of
	the selected primary memory physical address range.
	If you specify 0x0 offset then it will skip generating lower memory node.

config SUBSYSTEM_MEMORY_MANUAL_UPPER_BASEADDR
	hex "Upper memory base address"
	default 0x800000000
	depends on SUBSYSTEM_MEMORY_MANUAL_SELECT
	depends on SUBSYSTEM_ARCH_AARCH64
	help
	base address of the upper memory
	Make sure the DT memory entry should start with provided address.

config SUBSYSTEM_MEMORY_MANUAL_UPPER_MEMORYSIZE
	hex "Upper memory size"
	default 0x80000000
	depends on SUBSYSTEM_MEMORY_MANUAL_SELECT
	depends on SUBSYSTEM_ARCH_AARCH64
	help
	Size of the lower memory. Minimum is 32MB, maximum is the size of
	the selected primary memory physical address range.
	If you specify 0x0 offset then it will skip generating lower memory node.

endmenu

menu "Serial Settings"

choice
	prompt "PMUFW Serial stdin/stdout"
	help
	Select a serial as the PMUFW's stdin,stdout.
	If you select 'manual', you will need to add this variable
	YAML_SERIAL_CONSOLE_STDIN:forcevariable:pn-<recipename> = "<serial_ipname>"
	YAML_SERIAL_CONSOLE_STDOUT:forcevariable:pn-<recipename> = "<serial_ipname>"
	in petalinuxbsp.conf file to specify the stdin/stdout."

config SUBSYSTEM_PMUFW_SERIAL_PSU_UART_1_SELECT
	bool "psu_uart_1"

config SUBSYSTEM_PMUFW_SERIAL_PSU_UART_0_SELECT
	bool "psu_uart_0"

config SUBSYSTEM_PMUFW_SERIAL_MANUAL_SELECT
	bool "manual"

endchoice

choice
	prompt "FSBL Serial stdin/stdout"
	help
	Select a serial as the FSBL's stdin,stdout.
	If you select 'manual', you will need to add this variable
	YAML_SERIAL_CONSOLE_STDIN:forcevariable:pn-<recipename> = "<serial_ipname>"
	YAML_SERIAL_CONSOLE_STDOUT:forcevariable:pn-<recipename> = "<serial_ipname>"
	in petalinuxbsp.conf file to specify the stdin/stdout."

config SUBSYSTEM_FSBL_SERIAL_PSU_UART_1_SELECT
	bool "psu_uart_1"

config SUBSYSTEM_FSBL_SERIAL_PSU_UART_0_SELECT
	bool "psu_uart_0"

config SUBSYSTEM_FSBL_SERIAL_PSU_CORESIGHT_0_SELECT
	bool "psu_coresight_0"

config SUBSYSTEM_FSBL_SERIAL_MANUAL_SELECT
	bool "manual"

endchoice

choice
	prompt "TF-A Serial stdin/stdout"
	help
	Select a serial as the TF-A's stdin,stdout.
	If you select 'manual', you will need to add this variable
	ATF_CONSOLE:forcevariable = "<serial_ipname>" in petalinuxbps.conf

config SUBSYSTEM_TF-A_SERIAL_PSU_UART_1_SELECT
	bool "psu_uart_1"

config SUBSYSTEM_TF-A_SERIAL_PSU_UART_0_SELECT
	bool "psu_uart_0"

config SUBSYSTEM_TF-A_SERIAL_PSU_CORESIGHT_0_SELECT
	bool "psu_coresight_0"

config SUBSYSTEM_TF-A_SERIAL_MANUAL_SELECT
	bool "manual"

endchoice

choice
	prompt "U-boot/Linux Serial stdin/stdout"
	help
	Select a serial as the U-boot and Linux's stdin,stdout.
	If you select 'manual', you will need to add this variable
	YAML_SERIAL_CONSOLE_STDIN:forcevariable:pn-<recipename> = "<serial_ipname>"
	YAML_SERIAL_CONSOLE_STDOUT:forcevariable:pn-<recipename> = "<serial_ipname>"
	in petalinuxbsp.conf file to specify the stdin/stdout."

config SUBSYSTEM_SERIAL_PSU_UART_1_SELECT
	bool "psu_uart_1"

config SUBSYSTEM_SERIAL_PSU_UART_0_SELECT
	bool "psu_uart_0"

config SUBSYSTEM_SERIAL_PSU_CORESIGHT_0_SELECT
	bool "psu_coresight_0"

config SUBSYSTEM_SERIAL_MANUAL_SELECT
	bool "manual"

endchoice

choice
	prompt "System stdin/stdout baudrate for psu_uart_1"
	default SUBSYSTEM_SERIAL_PSU_UART_1_BAUDRATE_115200
	help
	Baudrate settings for serial Ip psu_uart_1
	The Baudrate setting applies only for U-boot/Linux serial Ip

config SUBSYSTEM_SERIAL_PSU_UART_1_BAUDRATE_600
	bool "600"

config SUBSYSTEM_SERIAL_PSU_UART_1_BAUDRATE_9600
	bool "9600"

config SUBSYSTEM_SERIAL_PSU_UART_1_BAUDRATE_28800
	bool "28800"

config SUBSYSTEM_SERIAL_PSU_UART_1_BAUDRATE_115200
	bool "115200"

config SUBSYSTEM_SERIAL_PSU_UART_1_BAUDRATE_230400
	bool "230400"

config SUBSYSTEM_SERIAL_PSU_UART_1_BAUDRATE_460800
	bool "460800"

config SUBSYSTEM_SERIAL_PSU_UART_1_BAUDRATE_921600
	bool "921600"

endchoice

choice
	prompt "System stdin/stdout baudrate for psu_uart_0"
	default SUBSYSTEM_SERIAL_PSU_UART_0_BAUDRATE_115200
	help
	Baudrate settings for serial Ip psu_uart_0
	The Baudrate setting applies only for U-boot/Linux serial Ip

config SUBSYSTEM_SERIAL_PSU_UART_0_BAUDRATE_600
	bool "600"

config SUBSYSTEM_SERIAL_PSU_UART_0_BAUDRATE_9600
	bool "9600"

config SUBSYSTEM_SERIAL_PSU_UART_0_BAUDRATE_28800
	bool "28800"

config SUBSYSTEM_SERIAL_PSU_UART_0_BAUDRATE_115200
	bool "115200"

config SUBSYSTEM_SERIAL_PSU_UART_0_BAUDRATE_230400
	bool "230400"

config SUBSYSTEM_SERIAL_PSU_UART_0_BAUDRATE_460800
	bool "460800"

config SUBSYSTEM_SERIAL_PSU_UART_0_BAUDRATE_921600
	bool "921600"

endchoice

choice
	prompt "System stdin/stdout baudrate for psu_coresight_0"
	default SUBSYSTEM_SERIAL_PSU_CORESIGHT_0_BAUDRATE_115200
	help
	Baudrate settings for serial Ip psu_coresight_0
	The Baudrate setting applies only for U-boot/Linux serial Ip

config SUBSYSTEM_SERIAL_PSU_CORESIGHT_0_BAUDRATE_600
	bool "600"

config SUBSYSTEM_SERIAL_PSU_CORESIGHT_0_BAUDRATE_9600
	bool "9600"

config SUBSYSTEM_SERIAL_PSU_CORESIGHT_0_BAUDRATE_28800
	bool "28800"

config SUBSYSTEM_SERIAL_PSU_CORESIGHT_0_BAUDRATE_115200
	bool "115200"

config SUBSYSTEM_SERIAL_PSU_CORESIGHT_0_BAUDRATE_230400
	bool "230400"

config SUBSYSTEM_SERIAL_PSU_CORESIGHT_0_BAUDRATE_460800
	bool "460800"

config SUBSYSTEM_SERIAL_PSU_CORESIGHT_0_BAUDRATE_921600
	bool "921600"

endchoice

config SUBSYSTEM_SERIAL_PMUFW_IP_NAME
	string
	default psu_uart_1 if SUBSYSTEM_PMUFW_SERIAL_PSU_UART_1_SELECT
	default psu_uart_0 if SUBSYSTEM_PMUFW_SERIAL_PSU_UART_0_SELECT

config SUBSYSTEM_SERIAL_FSBL_IP_NAME
	string
	default psu_uart_1 if SUBSYSTEM_FSBL_SERIAL_PSU_UART_1_SELECT
	default psu_uart_0 if SUBSYSTEM_FSBL_SERIAL_PSU_UART_0_SELECT
	default psu_coresight_0 if SUBSYSTEM_FSBL_SERIAL_PSU_CORESIGHT_0_SELECT

config SUBSYSTEM_SERIAL_TF-A_IP_NAME
	string
	default cadence1 if SUBSYSTEM_TF-A_SERIAL_PSU_UART_1_SELECT
	default cadence if SUBSYSTEM_TF-A_SERIAL_PSU_UART_0_SELECT
	default dcc if SUBSYSTEM_TF-A_SERIAL_PSU_CORESIGHT_0_SELECT

config SUBSYSTEM_SERIAL_IP_NAME
	string
	default psu_uart_1 if SUBSYSTEM_SERIAL_PSU_UART_1_SELECT
	default psu_uart_0 if SUBSYSTEM_SERIAL_PSU_UART_0_SELECT
	default psu_coresight_0 if SUBSYSTEM_SERIAL_PSU_CORESIGHT_0_SELECT

endmenu

menu "Ethernet Settings"

choice
	prompt "Primary Ethernet"
	help
	Select a Ethernet used as primary Ethernet.
	The primary ethernet will be used for u-boot networking if u-boot is
	selected and will be used as eth0 in Linux.
	If your preferred primary ethernet is not on the list, please select"
	'manual'.

config SUBSYSTEM_ETHERNET_MANUAL_SELECT
	bool "manual"

endchoice

endmenu

menu "Flash Settings"

choice
	prompt "Primary Flash"
	help
	Select a Flash instance used as Primary Flash.
	PetaLinux auto config will apply the flash partition table settings
	to the primary flash.
	If you preferred flash is not on the list or you don't want PetaLinux
	to manage your flash partition, please select manual.

config SUBSYSTEM_FLASH_MANUAL_SELECT
	bool "manual"

endchoice

endmenu

menu "SD/SDIO Settings"

choice
	prompt "Primary SD/SDIO"
	help
	Select a SD instanced used as primary SD/SDIO.
	It allows you to select which SD controller is in the systems primary SD card interface.

config SUBSYSTEM_PRIMARY_SD_PSU_SD_1_SELECT
	bool "psu_sd_1"

config SUBSYSTEM_PRIMARY_SD_PSU_SD_0_SELECT
	bool "psu_sd_0"

config SUBSYSTEM_PRIMARY_SD_MANUAL_SELECT
	bool "manual"

endchoice

endmenu

endif

endmenu
```
