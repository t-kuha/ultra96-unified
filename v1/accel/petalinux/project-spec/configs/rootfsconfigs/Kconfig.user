## v1/accel/petalinux/project-spec/configs/rootfsconfigs/Kconfig.user
```kconfig
menu "user packages " 
config fuse-exfat  
	 bool "fuse-exfat"
	 help
	
config gpio-demo  
	 bool "gpio-demo"
	 help
	
config lmsensors  
	 bool "lmsensors"
	 help
	
config peekpoke  
	 bool "peekpoke"
	 help
	
endmenu
```

## v2/accel/petalinux/project-spec/configs/configs/Kconfig.syshw
```kconfig
menuconfig SUBSYSTEM_HARDWARE_AUTO
	bool "Subsystem AUTO Hardware Settings"
	default y
	help
	  This menu is to configure system hardware.

if SUBSYSTEM_HARDWARE_AUTO


config SUBSYSTEM_PROCESSOR0_IP_NAME
string
default psu_cortexa53_0

choice
	prompt "System Processor"
	help
	 Select a processor as the system processor
config SUBSYSTEM_PROCESSOR_psu_cortexa53_0_SELECT
	bool "psu_cortexa53_0"

endchoice

config SUBSYSTEM_ENABLE_ARCH64
	bool
	default y
	select SUBSYSTEM_ARCH_AARCH64
	depends on SUBSYSTEM_PROCESSOR_psu_cortexa53_0_SELECT

if SUBSYSTEM_PROCESSOR_psu_cortexa53_0_SELECT
menu "Memory Settings"
choice
	prompt "Primary Memory"
	help
	  The configuration in this menu impacts the memory settings in the device tree
	  autoconfig files.
	  If you select 'manual', PetaLinux will auto generate memory node based on user inputs,
	  you will need to specify base address and memory size.
	  To skip generating lower or upper memory node specify 0x0 offset to the memory size.
	config SUBSYSTEM_MEMORY_PSU_DDR_0_BANKLESS_SELECT
	bool "psu_ddr_0"

config SUBSYSTEM_MEMORY_MANUAL_SELECT
	bool "manual"

	endchoice


config SUBSYSTEM_MEMORY_PSU_DDR_0_BANKLESS_BASEADDR
	hex "System memory base address"
	default 0x0
	range 0x0 0x7e000000
	depends on SUBSYSTEM_MEMORY_PSU_DDR_0_BANKLESS_SELECT
	help
	  Start address of the system memory.
	  It has to be within the selected primary memory physical address range.


config SUBSYSTEM_MEMORY_MANUAL_LOWER_BASEADDR
	hex "Lower memory base address"
	default 0x0
	depends on SUBSYSTEM_MEMORY_MANUAL_SELECT
	help
	  base address of the lower memory
	  Make sure the DT memory entry should start with provided address.


config SUBSYSTEM_MEMORY_PSU_DDR_0_BANKLESS_SIZE
	hex "System memory size"
	default 0x80000000
	range 0x2000000 0x80000000
	depends on SUBSYSTEM_MEMORY_PSU_DDR_0_BANKLESS_SELECT
	help
	  Size of the system memory. Minimum is 32MB, maximum is the size of
	  the selected primary memory physical address range.


config SUBSYSTEM_MEMORY_MANUAL_LOWER_MEMORYSIZE
	hex "Lower memory size"
	default 0x80000000
	depends on SUBSYSTEM_MEMORY_MANUAL_SELECT
	help
	  Size of the lower memory. Minimum is 32MB, maximum is the size of
	  the selected primary memory physical address range.
	  If you specify 0x0 offset then it will skip generating lower memory node.


config SUBSYSTEM_MEMORY_MANUAL_UPPER_BASEADDR
	hex "Upper memory base address"
	default 0x800000000
	depends on SUBSYSTEM_MEMORY_MANUAL_SELECT
	depends on SUBSYSTEM_ARCH_AARCH64
	help
	  base address of the upper memory
	  Make sure the DT memory entry should start with provided address.


config SUBSYSTEM_MEMORY_MANUAL_UPPER_MEMORYSIZE
	hex "Upper memory size"
	default 0x80000000
	depends on SUBSYSTEM_MEMORY_MANUAL_SELECT
	depends on SUBSYSTEM_ARCH_AARCH64
	help
	  Size of the upper memory. Minimum is 32MB, maximum is the size of
	  the selected primary memory physical address range.
	  If you specify 0x0 offset then it will skip generating upper memory node.


config SUBSYSTEM_MEMORY_PSU_DDR_0_BANKLESS_KERNEL_BASEADDR
	hex "kernel base address"
	default 0x0
	range 0x0 0x7e000000
	depends on SUBSYSTEM_MEMORY_PSU_DDR_0_BANKLESS_SELECT
	depends on SUBSYSTEM_ARCH_ARM || SUBSYSTEM_ARCH_AARCH64
	help
	  kernel base address.



config SUBSYSTEM_MEMORY_PSU_DDR_0_BANKLESS_U__BOOT_TEXTBASE_OFFSET
	hex "u-boot text base address offset to memory base address"
	default 0x100000
	range 0x100000 0x7e100000
	depends on SUBSYSTEM_MEMORY_PSU_DDR_0_BANKLESS_SELECT
	depends on !SUBSYSTEM_COMPONENT_U__BOOT_NAME_NONE
	help
	  u-boot offset to the memory base address. Minimum suggested is 1MB.



config SUBSYSTEM_MEMORY_IP_NAME
	string
	default PSU_DDR_0
	depends on SUBSYSTEM_MEMORY_PSU_DDR_0_BANKLESS_SELECT


endmenu

menu "Serial Settings"

choice
	prompt "PMUFW Serial stdin/stdout"

help
	  Select a serial as the PMUFW's stdin,stdout.
	  If you select 'manual', you will need to add this variable 
	  YAML_SERIAL_CONSOLE_STDIN:forcevariable:pn-PMUFW = "<serial_ipname>" 
	  YAML_SERIAL_CONSOLE_STDOUT:forcevariable:pn-PMUFW = "<serial_ipname>" 
config SUBSYSTEM_PMUFW_SERIAL_PSU_UART_1_SELECT
	bool "psu_uart_1"
config SUBSYSTEM_PMUFW_SERIAL_PSU_UART_0_SELECT
	bool "psu_uart_0"
config SUBSYSTEM_PMUFW_SERIAL_MANUAL_SELECT
bool "manual"
	endchoice

choice
	prompt "FSBL Serial stdin/stdout"

help
	  Select a serial as the FSBL's stdin,stdout.
	  If you select 'manual', you will need to add this variable 
	  YAML_SERIAL_CONSOLE_STDIN:forcevariable:pn-FSBL = "<serial_ipname>" 
	  YAML_SERIAL_CONSOLE_STDOUT:forcevariable:pn-FSBL = "<serial_ipname>" 
config SUBSYSTEM_FSBL_SERIAL_PSU_UART_1_SELECT
	bool "psu_uart_1"
config SUBSYSTEM_FSBL_SERIAL_PSU_UART_0_SELECT
	bool "psu_uart_0"
config SUBSYSTEM_FSBL_SERIAL_MANUAL_SELECT
bool "manual"
	endchoice

choice
	prompt "TF-A Serial stdin/stdout"

help
	  Select a serial as the TF-A's stdin,stdout.
	  If you select 'manual', you will need to add this variable 
	  YAML_SERIAL_CONSOLE_STDIN:forcevariable:pn-TF-A = "<serial_ipname>" 
	  YAML_SERIAL_CONSOLE_STDOUT:forcevariable:pn-TF-A = "<serial_ipname>" 

help
	  Select a serial as the TF-A's stdin,stdout.
	  If you select 'manual', you will need to add this variable 
	  ATF_CONSOLE:forcevariable = "<serial_ipname>" in petalinuxbps.conf 
config SUBSYSTEM_TF-A_SERIAL_PSU_UART_1_SELECT
	bool "psu_uart_1"
config SUBSYSTEM_TF-A_SERIAL_PSU_UART_0_SELECT
	bool "psu_uart_0"
config SUBSYSTEM_TF-A_SERIAL_MANUAL_SELECT
bool "manual"
	endchoice

choice
	prompt "DTG Serial stdin/stdout"

help
	  Select a serial as the DTG's stdin,stdout.
	  If you select 'manual', you will need to add this variable 
	  YAML_SERIAL_CONSOLE_STDIN:forcevariable:pn-DTG = "<serial_ipname>" 
	  YAML_SERIAL_CONSOLE_STDOUT:forcevariable:pn-DTG = "<serial_ipname>" 
config SUBSYSTEM_SERIAL_PSU_UART_1_SELECT
	bool "psu_uart_1"
config SUBSYSTEM_SERIAL_PSU_UART_0_SELECT
	bool "psu_uart_0"
config SUBSYSTEM_SERIAL_MANUAL_SELECT
bool "manual"
	endchoice


choice
	prompt "System stdin/stdout baudrate for psu_uart_1"
	default SUBSYSTEM_SERIAL_PSU_UART_1_BAUDRATE_115200
config SUBSYSTEM_SERIAL_PSU_UART_1_BAUDRATE_600
	bool "600"	
config SUBSYSTEM_SERIAL_PSU_UART_1_BAUDRATE_9600
	bool "9600"	
config SUBSYSTEM_SERIAL_PSU_UART_1_BAUDRATE_28800
	bool "28800"	
config SUBSYSTEM_SERIAL_PSU_UART_1_BAUDRATE_115200
	bool "115200"	
config SUBSYSTEM_SERIAL_PSU_UART_1_BAUDRATE_230400
	bool "230400"	
config SUBSYSTEM_SERIAL_PSU_UART_1_BAUDRATE_460800
	bool "460800"	
config SUBSYSTEM_SERIAL_PSU_UART_1_BAUDRATE_921600
	bool "921600"	
endchoice
choice
	prompt "System stdin/stdout baudrate for psu_uart_0"
	default SUBSYSTEM_SERIAL_PSU_UART_0_BAUDRATE_115200
config SUBSYSTEM_SERIAL_PSU_UART_0_BAUDRATE_600
	bool "600"	
config SUBSYSTEM_SERIAL_PSU_UART_0_BAUDRATE_9600
	bool "9600"	
config SUBSYSTEM_SERIAL_PSU_UART_0_BAUDRATE_28800
	bool "28800"	
config SUBSYSTEM_SERIAL_PSU_UART_0_BAUDRATE_115200
	bool "115200"	
config SUBSYSTEM_SERIAL_PSU_UART_0_BAUDRATE_230400
	bool "230400"	
config SUBSYSTEM_SERIAL_PSU_UART_0_BAUDRATE_460800
	bool "460800"	
config SUBSYSTEM_SERIAL_PSU_UART_0_BAUDRATE_921600
	bool "921600"	
endchoice


config SUBSYSTEM_SERIAL_PMUFW_IP_NAME
string
default psu_uart_1 if SUBSYSTEM_PMUFW_SERIAL_PSU_UART_1_SELECT
default psu_uart_0 if SUBSYSTEM_PMUFW_SERIAL_PSU_UART_0_SELECT

config SUBSYSTEM_SERIAL_FSBL_IP_NAME
string
default psu_uart_1 if SUBSYSTEM_FSBL_SERIAL_PSU_UART_1_SELECT
default psu_uart_0 if SUBSYSTEM_FSBL_SERIAL_PSU_UART_0_SELECT

config SUBSYSTEM_SERIAL_TF-A_IP_NAME
string
default cadence1 if SUBSYSTEM_TF-A_SERIAL_PSU_UART_1_SELECT
default cadence if SUBSYSTEM_TF-A_SERIAL_PSU_UART_0_SELECT

config SUBSYSTEM_SERIAL_IP_NAME
string
default psu_uart_1 if SUBSYSTEM_SERIAL_PSU_UART_1_SELECT
default psu_uart_0 if SUBSYSTEM_SERIAL_PSU_UART_0_SELECT

endmenu

menu "Ethernet Settings"
choice
	prompt "Primary Ethernet"
	help
	  Select a Ethernet used as primary Ethernet.
	  The primary ethernet will be used for u-boot networking if u-boot is
	  selected and will be used as eth0 in Linux.
	  If your preferred primary ethernet is not on the list, please select
	  'manual'.
config SUBSYSTEM_ETHERNET_MANUAL_SELECT
	bool "manual"

endchoice



endmenu

menu "Flash Settings"
choice
	prompt "Primary Flash"
	help
	  Select a Flash instance used as Primary Flash.
	  PetaLinux auto config will apply the flash partition table settings
	  to the primary flash.
	  If you preferred flash is not on the list or you don't want PetaLinux
	  to manage your flash partition, please select manual.
config SUBSYSTEM_FLASH_MANUAL_SELECT
	bool "manual"

endchoice



config SUBSYSTEM_FLASH__ADVANCED_AUTOCONFIG
	bool "Advanced Flash Auto Configuration"
	default n
	depends on !SUBSYSTEM_FLASH_MANUAL_SELECT
	help
	  Select this option to enabled 



endmenu

menu "SD/SDIO Settings"
choice
	prompt "Primary SD/SDIO"
	help
	  Select a SD instanced used as primary SD/SDIO.
	  It allows you to select which SD controller is in the systems primary SD card interface.
	config SUBSYSTEM_PRIMARY_SD_PSU_SD_1_SELECT
	bool "psu_sd_1"
config SUBSYSTEM_PRIMARY_SD_PSU_SD_0_SELECT
	bool "psu_sd_0"
config SUBSYSTEM_PRIMARY_SD_MANUAL_SELECT
	bool "manual"

	endchoice

endmenu

config SUBSYSTEM_SD_PSU_SD_1_SELECT
	bool
	default y
config SUBSYSTEM_SD_PSU_SD_0_SELECT
	bool
	default y


menu "RTC Settings"
choice
	prompt "Primary RTC"
	help
	  Select a RTC instance used as primary timer for Linux kernel.
	  If your preferred RTC is not on the list, please select 'manual'.
	  If 'manual' is selected, you will be responsible to enable property
	  kernel driver for your RTC.
	config SUBSYSTEM_RTC_PSU_RTC_SELECT
	bool "psu_rtc"
config SUBSYSTEM_RTC_MANUAL_SELECT
	bool "manual"

endchoice

endmenu



config SUBSYSTEM_I2C_PSU_I2C_1_SELECT
	bool
	default y


config SUBSYSTEM_USB_PSU_USB_1_SELECT
	bool
	default y
config SUBSYSTEM_USB_PSU_USB_0_SELECT
	bool
	default y


config SUBSYSTEM_DP_PSU_DP_SELECT
	bool
	default y


endif
endif
```

## v2/accel/petalinux/project-spec/configs/rootfsconfigs/Kconfig.user
```kconfig
menu "user packages " 
config fuse-exfat  
	 bool "fuse-exfat"
	 help
	
config gpio-demo  
	 bool "gpio-demo"
	 help
	
config peekpoke  
	 bool "peekpoke"
	 help
	
config wilc  
	 bool "wilc"
	 help
	
config wilc3000-fw  
	 bool "wilc3000-fw"
	 help
	
endmenu
```

## v2/vitis-ai/petalinux/project-spec/configs/rootfsconfigs/Kconfig.user
```kconfig
menu "user packages " 
config fuse-exfat  
	 bool "fuse-exfat"
	 help
	
config gpio-demo  
	 bool "gpio-demo"
	 help
	
config lmsensors  
	 bool "lmsensors"
	 help
	
config packagegroup-petalinux-jupyter  
	 bool "packagegroup-petalinux-jupyter"
	 help
	
config peekpoke  
	 bool "peekpoke"
	 help
	
config target-factory  
	 bool "target-factory"
	 help
	
config unilog  
	 bool "unilog"
	 help
	
config vart  
	 bool "vart"
	 help
	
config vitis-ai-library  
	 bool "vitis-ai-library"
	 help
	
config wilc  
	 bool "wilc"
	 help
	
config wilc3000-fw  
	 bool "wilc3000-fw"
	 help
	
config xir  
	 bool "xir"
	 help
	
endmenu
```
